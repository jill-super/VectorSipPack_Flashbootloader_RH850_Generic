VERSION ""

NS_ :

BS_:

BU_: Demo_1_CAN29 Demo_0_CAN11 Tester

BO_ 2564481441 Demo_1_CAN_Response: 8 Demo_1_CAN29
 SG_ Demo_1_CAN_Response : 0|64@1+ (1,0) [0|0] ""  Tester

BO_ 1456 Demo_0_CAN_Response: 8 Demo_0_CAN11
 SG_ Demo_0_CAN_Response : 0|64@1+ (1,0) [0|0] ""  Tester

BO_ 2564465121 Demo_1_CAN_Request: 8 Tester
 SG_ Demo_1_CAN_Request : 0|64@1+ (1,0) [0|0] ""  Demo_1_CAN29

BO_ 1440 Demo_0_CAN_Request: 8 Tester
 SG_ Demo_0_CAN_Request : 0|64@1+ (1,0) [0|0] ""  Demo_0_CAN11

BO_ 1911 Functional_CAN: 8 Tester
 SG_ Functional_CAN : 0|64@1+ (1,0) [0|0] ""  Demo_1_CAN29,Demo_0_CAN11

CM_ BU_ Demo_1_CAN29 "Classic CAN, physical 29 Bit identifiers, functional 11 Bit identifier";
CM_ BU_ Demo_0_CAN11 "Classic CAN, 11 Bit identifiers";
CM_ BU_ Tester "Classic CAN";
CM_ BO_ 2564481441 "Physical CAN response message (29 Bit ID)";
CM_ BO_ 1456 "Physical CAN response message (11 Bit ID)";
CM_ BO_ 2564465121 "Physical CAN request message (29 Bit ID)";
CM_ BO_ 1440 "Physical CAN request message (11 Bit ID)";
CM_ BO_ 1911 "Functional CAN message (11 Bit ID)";
BA_DEF_ BO_  "DiagFdOnly" ENUM  "no","yes";
BA_DEF_  "Manufacturer" STRING ;
BA_DEF_ BO_  "DiagState" ENUM  "no","yes";
BA_DEF_ BO_  "DiagResponse" ENUM  "no","yes";
BA_DEF_ BO_  "DiagRequest" ENUM  "no","yes";
BA_DEF_ BO_  "CANFD_BRS" ENUM  "0","1";
BA_DEF_  "DBName" STRING ;
BA_DEF_  "BusType" STRING ;
BA_DEF_ BO_  "VFrameFormat" ENUM  "StandardCAN","ExtendedCAN","reserved","reserved","reserved","reserved","reserved","reserved","reserved","reserved","reserved","reserved","reserved","reserved","StandardCAN_FD","ExtendedCAN_FD";
BA_DEF_DEF_  "DiagFdOnly" "yes";
BA_DEF_DEF_  "Manufacturer" "Vector";
BA_DEF_DEF_  "DiagState" "no";
BA_DEF_DEF_  "DiagResponse" "no";
BA_DEF_DEF_  "DiagRequest" "no";
BA_DEF_DEF_  "CANFD_BRS" "1";
BA_DEF_DEF_  "DBName" "";
BA_DEF_DEF_  "BusType" "";
BA_DEF_DEF_  "VFrameFormat" "StandardCAN";
BA_ "BusType" "CAN";
BA_ "DBName" "DemoFBL_Vector_SLP3";
BA_ "VFrameFormat" BO_ 2564481441 1;
BA_ "DiagResponse" BO_ 2564481441 1;
BA_ "CANFD_BRS" BO_ 2564481441 0;
BA_ "CANFD_BRS" BO_ 1456 0;
BA_ "DiagResponse" BO_ 1456 1;
BA_ "CANFD_BRS" BO_ 2564465121 0;
BA_ "VFrameFormat" BO_ 2564465121 1;
BA_ "DiagRequest" BO_ 2564465121 1;
BA_ "CANFD_BRS" BO_ 1440 0;
BA_ "DiagRequest" BO_ 1440 1;
BA_ "CANFD_BRS" BO_ 1911 0;
BA_ "DiagState" BO_ 1911 1;
