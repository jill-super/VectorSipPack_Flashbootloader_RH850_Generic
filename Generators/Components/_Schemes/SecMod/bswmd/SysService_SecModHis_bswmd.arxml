AUTOSAR XML (schema 3.0.1)
package /MICROSAR
  bsw implementation SysService_SecModHis_Impl: code-generator=cMICROSAR,GENy, programming-language=C, ar-major-version=3, ar-minor-version=0, ar-patch-version=1, vendor-specific-module-def=SysService_SecModHis_Def
  module definition SysService_SecModHis_Def
    container General
      integer SmhOperationMode: default-value=1  # Use this setting to enable/disable debug code in the Security Module. When the integration is done, set this switch to Production.
      string SmhUserConfigFile  # If a file path will be specified, the file is read and its contents are put at the end of the CAN config file.
      integer SmhOptimization: default-value=0
      boolean SmhDecryption: default-value=false  # Enables or disables the AES-decryption functionality of the security module.
      boolean SmhEncryption: default-value=false
      integer SmhCryptographicEncryptionKeys: default-value=0
      string SmhCryptographicEncryptionKeyArrayPrefix: default-value=SecM_
      integer SmhKeyConstant: default-value=0  # Use this setting to configure the key constant for the standard seed/key security access algorithm. This setting must correspond to setting in the diagnostic tool/CANflash tool.
      integer SmhKeyTimeout: default-value=100  # Used for configuring the timeout for a valid key. This timeout is active after the FBL has sent the seed values to the tester. If the security key is not received within the configured time (in ms), it will not be accepted. After the specifed time (in ms), the security key is set to invalid. Refer to the OEM reference manual for further details or deviations.
      integer SmhCallCycle: default-value=10  # The security module is cyclically called by the Bootloader, e.g. to check the key timeout. Enter the call cycle of the security module here (in ms).
      integer SmhCryptographicSeedKeyKeys: default-value=0
      string SmhCryptographicSeedKeyKeyArrayPrefix: default-value=SecSeedKey
      integer SmhHashAlgorithm: default-value=0  # Select the hash function for the security classes C and CCC
      integer SmhSecurityClass: default-value=0  # Specifies the security class of your ECU. The type of the security class is specified by the ECU responsible at the OEM.
      boolean SmhSecurityClassDDD: default-value=false
      boolean SmhSecurityClassC: default-value=false
      boolean SmhSecurityClassCCC: default-value=false
      boolean SmhSecurityClassVendor: default-value=false
      integer SmhCryptographicVerificationKeys: default-value=0
      string SmhCryptographicVerificationKeyArrayPrefix: default-value=SecM_
      integer SmhSizeOfVendorChecksum: 0..65535, default-value=1
      integer SmhMemoryAccessMode: default-value=0  # Type of memory access of the security module. Normally set to Memory Access - set this to File Access, if you have a file system on your ECU.
      integer SmhReadBufferSize: default-value=64  # Defines the number of bytes to be processed per block operation in the hash function
      boolean SmhIncludeAddressAndLengthInSignature: default-value=false  # Add the address and length information for every segment to the signature calculation.
      boolean SmhCRCTotal: default-value=false  # If enabled the security module calculates a CRC over an entire block during the verification process. This value can be used later on to verify the consistency of this flashblock.
      boolean SmhCRCWritten: default-value=false  # If enabled the security module calculates a CRC over the written data during the verification process. The resulting CRC is compared with the given reference value.
      boolean SmhVendorChecksum: default-value=false
      integer SmhSignatureOffset: default-value=0  # Specifies the offset to the signature within the verify input data stream
      integer SmhCRCOffset: default-value=0  # Specifies the offset to the CRC within the verify input data stream
      integer SmhFileType: default-value=0
      string SmhAuthenticityFile  # If a file path is specified here, the file is read and its contents are put into the file secmpar.c. If security class C or CCC is selected, you'll have to specifiy the path to the key file The file must contain a HEX data stream in the HIS-format in the very first line.
      string SmhINIFile  # Specify the path to an INI-file that contains one or more key information for the security classes C, CCC or AAA.
